## build_avt_fmc_4x4_example/conf/bblayers.conf
```bitbake
# POKY_BBLAYERS_CONF_VERSION is increased each time build/conf/bblayers.conf
# changes incompatibly
POKY_BBLAYERS_CONF_VERSION = "2"

BBPATH = "${TOPDIR}"
BBFILES ?= ""

BSPDIR := "${@os.path.abspath(os.path.dirname(d.getVar('FILE', True)) + '/../../xlnx-bsp')}"

BBLAYERS = " \
  ${BSPDIR}/poky/meta \
  ${BSPDIR}/poky/meta-poky \
  ${BSPDIR}/poky/meta-yocto-bsp \
  "
BBLAYERS += " \
  ${BSPDIR}/meta/meta-openembedded/meta-oe \
  ${BSPDIR}/meta/meta-openembedded/meta-python \
  ${BSPDIR}/meta/meta-openembedded/meta-networking \
  ${BSPDIR}/meta/meta-openembedded/meta-multimedia \
  ${BSPDIR}/meta/meta-qt5 \
  ${BSPDIR}/meta/meta-xilinx_2022.2/meta-xilinx-bsp \
  ${BSPDIR}/meta/meta-xilinx_2022.2/meta-xilinx-core \
  ${BSPDIR}/meta/meta-xilinx_2022.2/meta-xilinx-standalone \
  ${BSPDIR}/meta/meta-xilinx_2022.2/meta-xilinx-pynq \
  ${BSPDIR}/meta/meta-xilinx-tools_2022.2 \
"

# put that layer into a path outside the other BSP repositories
BBLAYERS += "${BSPDIR}/../allied_vision/meta-alvium-avt"
```

## build_avt_fmc_4x4_example/conf/local.conf
```bitbake
CONF_VERSION = "2"
EXTRA_IMAGE_FEATURES = "debug-tweaks"
USER_CLASSES ?= "buildstats"

PATCHRESOLVE = "noop"

BB_DISKMON_DIRS ??= "\
    STOPTASKS,${TMPDIR},1G,100K \
    STOPTASKS,${DL_DIR},1G,100K \
    STOPTASKS,${SSTATE_DIR},1G,100K \
    STOPTASKS,/tmp,100M,100K \
    ABORT,${TMPDIR},100M,1K \
    ABORT,${DL_DIR},100M,1K \
    ABORT,${SSTATE_DIR},100M,1K \
    ABORT,/tmp,10M,1K"

PACKAGECONFIG:append:pn-qemu-system-native = " sdl"
BB_SERVER_TIMEOUT = "300"

BB_DANGLINGAPPENDS_WARNONLY = "true"

#USER_CLASSES ?= "image-prelink"
#buildstats image-mklibs
USER_CLASSES ?= "buildstats"

MACHINE = "zcu106-zynqmp"

DISTRO = "poky"
PACKAGE_CLASSES = "package_deb"

DL_DIR = "/opt/yocto/downloads"
BB_GENERATE_MIRROR_TARBALLS = "1"

BB_NUMBER_THREADS = "6"
PARALLEL_MAKE = "-j6"

DISTRO_FEATURES:append = " wayland "

RDEPENDS_xserver-xorg-xwayland = " libmali-xlnx "
RDEPENDS_xserver-xorg = " libmali-xlnx  "
RDEPENDS_cogl-1.0-examples = " libmali-xlnx  "
RDEPENDS_libcogl-path = " libmali-xlnx  "
RDEPENDS_libcogl-pango = " libmali-xlnx  "
RDEPENDS_libcogl = " libmali-xlnx  "
RDEPENDS_clutter-1.0 = " libmali-xlnx  "

MACHINE_ESSENTIAL_EXTRA_RRECOMMENDS += "kernel-modules"

MALI_BACKEND_DEFAULT = "wayland"
#MALI_BACKEND_DEFAULT = "x11 "

DISTRO_FEATURES:append = " wayland "

EXTRA_IMAGE_FEATURES += " \
			debug-tweaks \
			ssh-server-openssh \
			eclipse-debug \
			package-management \
			"

PACKAGECONFIG_pn:kmscube += " gstreamer "

PACKAGECONFIG_pn:weston:append = " xwayland screenshare shell-desktop image-jpeg remoting screenshare shell-desktop"

#YAML_DT_BOARD_FLAGS = "{BOARD zcu106-reva}"
YAML_OVERLAY_CUSTOM_DTS="zcu106-alvium-4x4-mipi-fmc"
YAML_COMPILER_FLAGS = "-DFSBL_DEBUG_INFO"

SYSTEM_USER_DTSI = "zcu106-alvium-4x4-mipi-fmc.dtsi"

HDF_BRANCH = "main"
HDF_SRCREV = "4f0f401d7eca7b107f960ef5b3ee457cf0827d9c"

HDF_AVT_GIT_HOST ?= "github.com/alliedvision"
HDF_AVT_GIT_REPO ?= "zynq-mipi-bitstreams"
HDF_AVT_GIT_PROTOCOL ?= "https"


HDF_BASE = "git://"
HDF_PATH = "git@${HDF_AVT_GIT_HOST}/${HDF_AVT_GIT_REPO};branch=${BRANCH};protocol=${HDF_AVT_GIT_PROTOCOL}"
HDF_NAME = "${S}/git/zcu106avt_fmc_4x4_wrapper_750x4YUV422_8bit_750x4YUV422_8bit_750x4YUV422_8bit_750x4YUV422_8bit.xsa"


BUILD_REPRODUCIBLE_BINARIES_pn:linux-xlnx = "0"
BUILD_REPRODUCIBLE_BINARIES_pn:u-boot-xlnx = "0"


#optional to generate fitimage
KERNEL_CLASSES += "kernel-fitimage"
KERNEL_IMAGETYPES += " fitImage"

UBOOT_ENTRYPOINT_zynqmp = "0x8000000"
UBOOT_LOADADDRESS_zynqmp = "0x8000000"

LICENSE_FLAGS_WHITELIST += "xilinx_pmu-rom-native"


PACKAGECONFIG_pn:v4l-utils += " qv4l2 "
#PREFERRED_VERSION:v4l-utils = "1.22%"
PREFERRED_VERSION:v4l-utils = "1.23%"

INHERIT+="toaster buildhistory"

include avt_git_override.conf
```

## build_imx8mp_evk_example/conf/local.conf
```bitbake
MACHINE = 'imx8mpevk'
DISTRO ?= 'fsl-imx-xwayland'
PACKAGE_CLASSES ?= 'package_rpm'
EXTRA_IMAGE_FEATURES ?= "debug-tweaks"
USER_CLASSES ?= "buildstats"
PATCHRESOLVE = "noop"
BB_DISKMON_DIRS ??= "\
    STOPTASKS,${TMPDIR},1G,100K \
    STOPTASKS,${DL_DIR},1G,100K \
    STOPTASKS,${SSTATE_DIR},1G,100K \
    STOPTASKS,/tmp,100M,100K \
    HALT,${TMPDIR},100M,1K \
    HALT,${DL_DIR},100M,1K \
    HALT,${SSTATE_DIR},100M,1K \
    HALT,/tmp,10M,1K"
PACKAGECONFIG:append:pn-qemu-system-native = " sdl"
CONF_VERSION = "2"

ACCEPT_FSL_EULA = "1"

# Switch to Debian packaging and include package-management in the image
PACKAGE_CLASSES = "package_deb"
EXTRA_IMAGE_FEATURES += "package-management"

SOURCE_MIRROR_URL = "file:///opt/yocto/downloads/"
INHERIT += "own-mirrors"

DL_DIR = "/opt/yocto/downloads"
BB_GENERATE_MIRROR_TARBALLS = "1"
#BB_NO_NETWORK = "1"

BB_NUMBER_THREADS = "6"
PARALLEL_MAKE = "-j8"

SDK_EXT_TYPE = "minimal"

SSTATE_DIR = "sstate-cache"

LICENSE_FLAGS_ACCEPTED += "\
	commercial_gst-fluendo-mp3 \
	commercial_gst-openmax \
	commercial_gst-plugins-ugly \
	commercial_lame \
	commercial_ffmpeg \
	commercial_libmad \
	commercial_libomxil \
	commercial_mpeg2dec \
	commercial_qmmp \
	commercial_x264 \
	commercial_libav \
	commercial_gstreamer1.0 \
	commercial_gstreamer1.0-libav \
	commercial_gstreamer1.0-meta-base \
	commercial_gstreamer1.0-omx \
	commercial_gstreamer1.0-plugins-bad \
	commercial_gstreamer1.0-plugins-base \
	commercial_gstreamer1.0-plugins-good \
	commercial_gstreamer1.0-plugins-ugly \
	commercial_gstreamer1.0-python \
	commercial_gstreamer1.0-rtsp-server \
	commercial_gstreamer1.0-vaapi \
	commercial_faad2 \
	commercial_faac \
	commercial_vlc \
	"

IMAGE_FSTYPES = "wic.bmap wic.bz2 tar.bz2"

KERNEL_DEVICETREE:append:imx8mpevk = " \
	freescale/imx8mp-evk-alvium.dtb \
	freescale/imx8mp-evk-alvium-fpdlink.dtb \
	"
```

## conf/layer.conf
```bitbake
# We have a conf and classes directory, add to BBPATH
BBPATH .= ":${LAYERDIR}"

# We have a packages directory, add to BBFILES
BBFILES += "${LAYERDIR}/recipes-*/*/*.bb"
BBFILES += "${LAYERDIR}/recipes-*/*/*.bbappend"

BBFILE_COLLECTIONS += "alvium-avt-layer"
BBFILE_PATTERN_alvium-avt-layer := "^${LAYERDIR}/"
BBFILE_PRIORITY_alvium-avt-layer = "8"

LAYERDEPENDS_alvium-avt-layer = "core openembedded-layer"

LAYERSERIES_COMPAT_alvium-avt-layer = " honister kirkstone langdale "

#LICENSE_PATH += "${LAYERDIR}/licenses"

BBFILES_DYNAMIC += " \
 	qt5-layer:${LAYERDIR}/dynamic-layers/qt5-layer/*/*/*.bb \
	qt5-layer:${LAYERDIR}/dynamic-layers/qt5-layer/*/*/*.bbappend \
 	qt6-layer:${LAYERDIR}/dynamic-layers/qt6-layer/*/*/*.bb \
	qt6-layer:${LAYERDIR}/dynamic-layers/qt6-layer/*/*/*.bbappend \
	xilinx-bsp:${LAYERDIR}/dynamic-layers/xilinx-bsp/recipes-*/*/*.bb \
    xilinx-bsp:${LAYERDIR}/dynamic-layers/xilinx-bsp/recipes-*/*/*.bbappend \
    fsl-bsp-release:${LAYERDIR}/dynamic-layers/fsl-bsp-release/*/*/*.bb \
    fsl-bsp-release:${LAYERDIR}/dynamic-layers/fsl-bsp-release/*/*/*.bbappend \
	"

# This should only be incremented on significant changes that will
# cause compatibility issues with other layers
LAYERVERSION_alvium-avt-layer = "1"
```
